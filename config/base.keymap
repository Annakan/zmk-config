#include <behaviors.dtsi>
#include <behaviors/num_word.dtsi> // Requires auto-layer module.
#include <dt-bindings/zmk/keys.h>
#ifdef CONFIG_WIRELESS
  #include <dt-bindings/zmk/bt.h>
  #include <dt-bindings/zmk/outputs.h>
  #define _BT_SEL_KEYS_                                                        \
      &bt BT_SEL 0 &bt BT_SEL 1 &bt BT_SEL 2 &bt BT_SEL 3 &bt BT_CLR
#else
  #define _BT_SEL_KEYS_ &trans &trans &trans &trans &trans
#endif

#include "zmk-helpers/helper.h"
#include "zmk-helpers/unicode-chars/greek.dtsi"
#include "zmk-helpers/unicode-chars/german.dtsi"


/* Global defaults */


#define XXX &none
#define ___ &trans

#define DEF 0
#define QWERTY 0
#define ErgoL 1
#define NAV 2
#define FN 3
#define NUM 4
#define MOUSE 5
#define SYS 6
#define OSTOGL 7
#define LINACC 8
#define WMACC 9
#define SYMBOL 10


#define QUICK_TAP_MS 175

&sk {
  release-after-ms = <900>;
  quick-release;
};

&sl { // Allow sticky mods to chord across sticky layers.
  ignore-modifiers;
};

&lt {
  flavor = "balanced";
  tapping-term-ms = <200>;
  quick-tap-ms = <QUICK_TAP_MS>;
};

/* Homerow mods */

#define KEYS_L 			 LC5 LC4 LC3 LC2 LC1 \
                         LN5 LN4 LN3 LN2 LN1 LN0 \
                         LT5 LT4 LT3 LT2 LT1 LT0 \
                         LM5 LM4 LM3 LM2 LM1 LM0 \
                         LB5 LB4 LB3 LB2 LB1 LB0 \
                         LF5 LF4 LF3 LF2 LF1
#define KEYS_R 				 RC1 RC2 RC3 RC4 RC5 \
                         RN0 RN1 RN2 RN3 RN4 RN5 \
                         RT0 RT1 RT2 RT3 RT4 RT5 \
                         RM0 RM1 RM2 RM3 RM4 RM5 \
                         RB0 RB1 RB2 RB3 RB4 RB5 \
                             RF1 RF2 RF3 RF4 RF5

#define THUMBS LH5 LH4 LH3     RH3 RH4 RH5 \
               LH2 LH1 LH0     RH0 RH1 RH2 // Thumbs on Glove80.

#define MAKE_HRM(NAME, HOLD, TAP, TRIGGER_POS)                                 \
  ZMK_HOLD_TAP(NAME, bindings = <HOLD>, <TAP>; flavor = "balanced";            \
               tapping-term-ms = <280>; quick-tap-ms = <QUICK_TAP_MS>;         \
               require-prior-idle-ms = <150>; hold-trigger-on-release;         \
               hold-trigger-key-positions = <TRIGGER_POS>;)

MAKE_HRM(hml, &kp, &kp, KEYS_R THUMBS) // Left-hand HRMs.
MAKE_HRM(hmr, &kp, &kp, KEYS_L THUMBS) // Right-hand HRMs.

// Hack: Make HRM combos tap-only (cf, ZMK issue #544).
#define ZMK_COMBO_8(NAME, TAP, POS, LAYERS, COMBO_MS, IDLE_MS, HOLD, SIDE)     \
  MAKE_HRM(hm_combo_##NAME, &kp, TAP, SIDE THUMBS)                             \
  ZMK_COMBO_6(NAME, &hm_combo_##NAME HOLD 0, POS, LAYERS, COMBO_MS, IDLE_MS)

/* Combos, leader key sequences, mouse emulation */

#include "combos.dtsi" // Must be sourced after HRM-combo hack.
#include "leader.dtsi"
#include "mouse.dtsi"
#include <dt-bindings/zmk/rgb.h>

/* Nav cluster */

// Trigger tap-action on all interrupts.
#define MT_CORE                                                                \
  flavor = "tap-preferred";                                                    \
  tapping-term-ms = <220>;                                                     \
  quick-tap-ms = <220>;                                                        \
  hold-trigger-key-positions = <0>;

&mt { MT_CORE };

ZMK_HOLD_TAP(mt_home, bindings = <&masked_home>, <&kp>; MT_CORE)
ZMK_HOLD_TAP(mt_end, bindings = <&masked_end>, <&kp>; MT_CORE)

#define NAV_LEFT  &mt_home 0   LEFT  // Tap: left  | Long-tap: start of line.
#define NAV_RIGHT &mt_end 0    RIGHT // Tap: right | Long-tap: end   of line.
#define NAV_UP    &mt LC(HOME) UP    // Tap: up    | Long-tap: start of doc.
#define NAV_DOWN  &mt LC(END)  DOWN  // Tap: down  | Long-tap: end   of doc.
#define NAV_BSPC  &mt LC(BSPC) BSPC  // Tap: bspc  | Long-tap: delete word bwd.
#define NAV_DEL   &mt LC(DEL)  DEL   // Tap: del   | Long-tap: delete word fwd.

// Mask CTRL on left/right hold to avoid accidental jumps to start/end of doc.
#define MASK_MODS(NAME, MODS, BINDING)                                         \
  ZMK_MOD_MORPH(NAME, bindings = <BINDING>, <BINDING>; mods = <MODS>;)

MASK_MODS(masked_home, (MOD_LCTL), &kp HOME)
MASK_MODS(masked_end,  (MOD_LCTL), &kp END)

/* Magic-shift & auto-layers */

// Tap: repeat after alpha, else sticky-shift |
// Shift + tap/ double-tap: caps-word | Hold: shift.
#define MAGIC_SHIFT &magic_shift LSHFT 0
ZMK_HOLD_TAP(magic_shift, bindings = <&kp>, <&magic_shift_tap>;
             flavor = "balanced"; tapping-term-ms = <200>;
             quick-tap-ms = <QUICK_TAP_MS>;)
ZMK_MOD_MORPH(magic_shift_tap, bindings = <&shift_repeat>, <&caps_word>;
              mods = <(MOD_LSFT)>;)
ZMK_ADAPTIVE_KEY(
    shift_repeat, bindings = <&sk LSHFT>;
    repeat {
      trigger-keys = <A B C D E F G H I J K L M N O P Q R S T U V W X Y Z>;
      bindings = <&key_repeat>;
      max-prior-idle-ms = <1200>;
      strict-modifiers;
    };)

/* Standard Glove80 behaviors and macros */

// For the "layer" key, it'd nice to be able to use it as either a shift or a toggle.
// Configure it as a tap dance, so the first tap (or hold) is a &mo and the second tap is a &to
ZMK_BEHAVIOR(layer, tap_dance,
    bindings = <&mo 1>, <&to 1>;
    tapping-term-ms = <200>;
)

ZMK_BEHAVIOR(magic, hold_tap,
    flavor = "tap-preferred";
    bindings = <&mo>, <&rgb_ug_status_macro>;
    tapping-term-ms = <200>;
)

ZMK_BEHAVIOR(rgb_ug_status_macro, macro,
    bindings = <&rgb_ug RGB_STATUS>;
)

ZMK_BEHAVIOR(bt_sel, macro_one_param,
    bindings = <&out OUT_BLE>, <&macro_param_1to2>, <&bt BT_SEL MACRO_PLACEHOLDER>;
)

/*   Main config   */

&caps_word { // Mods deactivate caps-word, requires PR #1451. [TODO: rebase]
  /delete-property/ ignore-modifiers;
};

// Tap: num-word | double-tap: sticky num-layer | Hold: num-layer.
#define SMART_NUM &smart_num NUM 0
ZMK_HOLD_TAP(smart_num, bindings = <&mo>, <&num_dance>; flavor = "balanced";
             tapping-term-ms = <200>; quick-tap-ms = <QUICK_TAP_MS>;)
ZMK_TAP_DANCE(num_dance, bindings = <&num_word NUM>, <&sl NUM>;
              tapping-term-ms = <200>;)

// Smart-mouse, requires tri-state module.
ZMK_TRI_STATE(
    smart_mouse, bindings = <&tog MOUSE>, <&none>, <&tog MOUSE>;
    ignored-key-positions =
        <LT1 LT2 LH0 LH1 RT1 RT2 RT3 RM0 RM1 RM2 RM3 RM4 RB1 RB2 RB3 RH0 RH1>;
    ignored-layers = <MOUSE NAV FN>;)

/* Custom behaviors */


// Alt+Tab swapper, requires tri-state module.
ZMK_TRI_STATE(swapper, bindings = <&kt LALT>, <&kp TAB>, <&kt LALT>;
              ignored-key-positions = <LT2 RT2 RM1 RM2 RM3>;)

// Define mod-morph with a *single* mod trigger for less repetition.
#define SIMPLE_MORPH(NAME, MOD, BINDING1, BINDING2)                            \
  ZMK_MOD_MORPH(NAME, mods = <(MOD_L##MOD | MOD_R##MOD)>;                      \
                bindings = <BINDING1>, <BINDING2>;)

// Tap: comma | Shift + tap: semicolon | Ctrl + shift + tap: <.
SIMPLE_MORPH(comma_morph, SFT, &kp COMMA, &comma_inner_morph)
SIMPLE_MORPH(comma_inner_morph, CTL, &kp SEMICOLON, &kp LESS_THAN)

// Tap: dot | Shift + tap: colon | Ctrl + shift + tap: >.
SIMPLE_MORPH(dot_morph, SFT, &kp DOT, &dot_inner_morph)
SIMPLE_MORPH(dot_inner_morph, CTL, &kp COLON, &kp GREATER_THAN)

// Tap: qmark | Shift + tap: excl.
SIMPLE_MORPH(qexcl, SFT, &kp QMARK, &kp EXCL)

// Tap: left/right parenthesis | Shft + tap: less-than/greater-than.
SIMPLE_MORPH(lpar_lt, SFT, &kp LPAR, &kp LT)
SIMPLE_MORPH(rpar_gt, SFT, &kp RPAR, &kp GT)

// Tap: space | Shift + tap: dot -> space -> sticky shift | Hold: nav layer.
ZMK_HOLD_TAP(lt_spc, bindings = <&mo>, <&spc_morph>; flavor = "balanced";
             tapping-term-ms = <200>; quick-tap-ms = <QUICK_TAP_MS>;)
SIMPLE_MORPH(spc_morph, SFT, &kp SPACE, &dot_spc)
ZMK_MACRO(dot_spc, bindings = <&kp DOT &kp SPACE &sk LSHFT>; wait-ms = <0>;
          tap-ms = <5>;)

// Tap: backspace | Lshft + tap: delete | Rshft + tap: shift-delete.
ZMK_MOD_MORPH(bs_del, bindings = <&kp BSPC>, <&kp DEL>;
              mods = <(MOD_LSFT|MOD_RSFT)>; keep-mods = <MOD_RSFT>;)

// Tap: copy | double-tap: cut.
ZMK_TAP_DANCE(copy_cut, bindings = <&kp LC(INS)>, <&kp LC(X)>;
              tapping-term-ms = <200>;)

// Sticky shift + leader.
ZMK_MACRO(leader_sft, bindings = <&sk LSHFT &leader>;)

// Misc aliases. [TODO: clean up]
#define CANCEL    &kp K_CANCEL            // Cancel caps-word & auto-layers.
#define DSK_PREV  &hmr LCTRL LG(LC(LEFT)) // Previous desktop.
#define DSK_NEXT  &hmr LALT LG(LC(RIGHT)) // Next     desktop.
#define PIN_WIN   &kp LG(LC(LS(Q)))       // Pin window across desktops.
#define PIN_APP   &kp LG(LC(LS(A)))       // Pin application across desktops.
#define DSK_MGR   &kp LA(GRAVE)           // Desktop manager.
#define VOL_DOWN  &hmr RSHFT C_VOL_DN

// QWERTY Morphs

// Tap: semicolon | Shift + tap: colon
SIMPLE_MORPH(q_scol_col, SFT, &kp SEMICOLON, &kp COLON)

// Tap: ' | Shift + tap: "
SIMPLE_MORPH(q_quote_sqt, SFT, &kp SQT,  &kp DOT )

// Tap: , | Shift + tap: <
SIMPLE_MORPH(q_comma_lt, SFT, &kp COMMA,  &kp LESS_THAN )

// Tap: . | Shift + tap: >
SIMPLE_MORPH(q_dot_gt, SFT, &kp DOT,  &kp GREATER_THAN )

// Tap: ~ | Shift + tap: `
SIMPLE_MORPH(q_grave_tilde, SFT, &kp TILDE,  &kp GRAVE )

// Tap: slash / | Shift + tap: ?
SIMPLE_MORPH(q_slash_qmark, SFT, &kp FSLH,  &kp QMARK )

// Tap: slash - | Shift + tap: _
SIMPLE_MORPH(q_minus_unders, SFT, &kp MINUS,  &kp UNDER )

// Tap: slash \ | Shift + tap: |
SIMPLE_MORPH(q_rslsh_pipe, SFT, &kp BSLH,  &kp PIPE )

// Tap: slash = | Shift + tap: +
SIMPLE_MORPH(q_eql_plus, SFT, &kp EQUAL,  &kp PLUS )

// Tap: slash [ | Shift + tap: {
SIMPLE_MORPH(q_lbkt_lcbkt, SFT, &kp LBRC,  &kp LBKT )

// Tap: slash = ] Shift + tap: }
SIMPLE_MORPH(q_rbkt_rcbkt, SFT, &kp RBRC,  &kp RBKT )


// Ergo-L Morphs et co

#define Q_DEAD_KEY &q_deadk LINACC  0
SIMPLE_MORPH(q_deadk_excl, SFT, &sl LINACC, &kp EXCL)
// Tap: ergo dead-key | Shift + dead=key: ! | Hold: dead-key layer.
ZMK_HOLD_TAP(q_deadk, bindings = <&mo>, <&q_deadk_excl>; flavor = "balanced";
             tapping-term-ms = <200>; quick-tap-ms = <QUICK_TAP_MS>;)


ZMK_CONDITIONAL_LAYER(acc, ErgoL OSTOGL LINACC, WMACC)

// Unicode

// NOTE : You can't use unicode inside the keymap files !!!!

ZMK_UNICODE_SINGLE_AOS(left_doubl_angle , N0 , N0 , A , B) //«  |  wm_left_doubl_angle lin_left_doubl_angle LEFT-POINTING DOUBLE ANGLE QUOTATION MARK
ZMK_UNICODE_SINGLE_AOS(right_doubl_angle , N0 , N0 , B , B) //»  |  wm_right_doubl_angle lin_right_doubl_angle RIGHT-POINTING DOUBLE ANGLE QUOTATION MARK
ZMK_UNICODE_SINGLE_AOS(doubl_low_9 , N2 , N0 , N1 , E) //„  |  wm_doubl_low_9 lin_doubl_low_9 DOUBLE LOW-9 QUOTATION MARK
ZMK_UNICODE_SINGLE_AOS(euro_sign , N2 , N0 , A , C) //€  |  wm_euro_sign lin_euro_sign EURO SIGN
ZMK_UNICODE_PAIR_AOS(a_grave , N0 , N0 , E , N0 , N0 , N0 , C , N0) //à À |  wm_a_grave lin_a_grave LATIN SMALL LETTER A WITH GRAVE
ZMK_UNICODE_PAIR_AOS(e_grave , N0 , N0 , E , N8 , N0 , N0 , C , N8) //è È |  wm_e_grave lin_e_grave LATIN SMALL LETTER E WITH GRAVE
ZMK_UNICODE_PAIR_AOS(u_grave , N0 , N0 , F , N9 , N0 , N0 , D , N9) //ù Ù |  wm_u_grave lin_u_grave LATIN SMALL LETTER U WITH GRAVE
ZMK_UNICODE_PAIR_AOS(c_cedil , N0 , N0 , E , N7 , N0 , N0 , C , N7) //ç Ç |  wm_c_cedil lin_c_cedil LATIN SMALL LETTER C WITH CEDILLA
ZMK_UNICODE_PAIR_AOS(ligat_oe , N0 , N1 , N5 , N3 , N0 , N1 , N5 , N2) //œ Œ |  wm_ligat_oe lin_ligat_oe LATIN SMALL LIGATURE OE
ZMK_UNICODE_PAIR_AOS(e_acute , N0 , N0 , E , N9 , N0 , N0 , C , N9) //é É |  wm_e_acute lin_e_acute LATIN SMALL LETTER E WITH ACUTE
ZMK_UNICODE_PAIR_AOS(a_circu , N0 , N0 , E , N2 , N0 , N0 , C , N2) //â Â |  wm_a_circu lin_a_circu LATIN SMALL LETTER A WITH CIRCUMFLEX
ZMK_UNICODE_PAIR_AOS(e_circu , N0 , N0 , E , A , N0 , N0 , C , A) //ê Ê |  wm_e_circu lin_e_circu LATIN SMALL LETTER E WITH CIRCUMFLEX
ZMK_UNICODE_PAIR_AOS(i_circu , N0 , N0 , E , E , N0 , N0 , C , E) //î Î |  wm_i_circu lin_i_circu LATIN SMALL LETTER I WITH CIRCUMFLEX
ZMK_UNICODE_PAIR_AOS(o_circu , N0 , N0 , F , N4 , N0 , N0 , D , N4) //ô Ô |  wm_o_circu lin_o_circu LATIN SMALL LETTER O WITH CIRCUMFLEX
ZMK_UNICODE_PAIR_AOS(u_circu , N0 , N0 , F , B , N0 , N0 , D , B) //û Û |  wm_u_circu lin_u_circu LATIN SMALL LETTER U WITH CIRCUMFLEX
ZMK_UNICODE_PAIR_AOS(ae , N0 , N0 , E , N6 , N0 , N0 , C , N6) //æ Æ |  wm_ae lin_ae LATIN SMALL LETTER AE
ZMK_UNICODE_PAIR_AOS(micro_sign , N0 , N0 , B , N5 , N0 , N3 , N9 , C) //µ Μ |  wm_micro_sign lin_micro_sign MICRO SIGN
UC_MACRO_AOS(sharp_s_lower, &kp N0 &kp N0 &kp D &kp F)
UC_MODMORPH(wm_sharp_s, &wm_sharp_s_lower, &kp S &kp S)
UC_MODMORPH(lin_sharp_s, &lin_sharp_s_lower, &kp S &kp S) //ß  |  wm_sharp_s lin_sharp_s LATIN SMALL LETTER SHARP S
ZMK_UNICODE_PAIR_AOS(n_tilde , N0 , N0 , F , N1 , N0 , N0 , D , N1) //ñ Ñ |  wm_n_tilde lin_n_tilde LATIN SMALL LETTER N WITH TILDE
ZMK_UNICODE_PAIR_AOS(a_diaer , N0 , N0 , E , N4 , N0 , N0 , C , N4) //ä Ä |  wm_a_diaer lin_a_diaer LATIN SMALL LETTER A WITH DIAERESIS
ZMK_UNICODE_PAIR_AOS(e_diaer , N0 , N0 , E , B , N0 , N0 , C , B) //ë Ë |  wm_e_diaer lin_e_diaer LATIN SMALL LETTER E WITH DIAERESIS
ZMK_UNICODE_PAIR_AOS(i_diaer , N0 , N0 , E , F , N0 , N0 , C , F) //ï Ï |  wm_i_diaer lin_i_diaer LATIN SMALL LETTER I WITH DIAERESIS
ZMK_UNICODE_PAIR_AOS(o_diaer , N0 , N0 , F , N6 , N0 , N0 , D , N6) //ö Ö |  wm_o_diaer lin_o_diaer LATIN SMALL LETTER O WITH DIAERESIS
ZMK_UNICODE_PAIR_AOS(u_diaer , N0 , N0 , F , C , N0 , N0 , D , C) //ü Ü |  wm_u_diaer lin_u_diaer LATIN SMALL LETTER U WITH DIAERESIS
ZMK_UNICODE_PAIR_AOS(y_diaer , N0 , N0 , F , F , N0 , N1 , N7 , N8) //ÿ Ÿ |  wm_y_diaer lin_y_diaer LATIN SMALL LETTER Y WITH DIAERESIS
ZMK_UNICODE_SINGLE_AOS(horiz_ellip , N2 , N0 , N2 , N6) //…  |  wm_horiz_ellip lin_horiz_ellip HORIZONTAL ELLIPSIS
ZMK_UNICODE_SINGLE_AOS(verti_horiz_ellip , F , E , N1 , N9) //︙  |  wm_verti_horiz_ellip lin_verti_horiz_ellip PRESENTATION FORM FOR VERTICAL HORIZONTAL ELLIPSIS
ZMK_UNICODE_PAIR_AOS(alpha , N0 , N3 , B , N1 , N0 , N3 , N9 , N1) //α Α |  wm_alpha lin_alpha GREEK SMALL LETTER ALPHA
ZMK_UNICODE_PAIR_AOS(beta , N0 , N3 , B , N2 , N0 , N3 , N9 , N2) //β Β |  wm_beta lin_beta GREEK SMALL LETTER BETA
ZMK_UNICODE_PAIR_AOS(gamma , N0 , N3 , B , N3 , N0 , N3 , N9 , N3) //γ Γ |  wm_gamma lin_gamma GREEK SMALL LETTER GAMMA
ZMK_UNICODE_PAIR_AOS(delta , N0 , N3 , B , N4 , N0 , N3 , N9 , N4) //δ Δ |  wm_delta lin_delta GREEK SMALL LETTER DELTA
ZMK_UNICODE_PAIR_AOS(epsil , N0 , N3 , B , N5 , N0 , N3 , N9 , N5) //ε Ε |  wm_epsil lin_epsil GREEK SMALL LETTER EPSILON
ZMK_UNICODE_PAIR_AOS(zeta , N0 , N3 , B , N6 , N0 , N3 , N9 , N6) //ζ Ζ |  wm_zeta lin_zeta GREEK SMALL LETTER ZETA
ZMK_UNICODE_PAIR_AOS(eta , N0 , N3 , B , N7 , N0 , N3 , N9 , N7) //η Η |  wm_eta lin_eta GREEK SMALL LETTER ETA
ZMK_UNICODE_PAIR_AOS(theta , N0 , N3 , B , N8 , N0 , N3 , N9 , N8) //θ Θ |  wm_theta lin_theta GREEK SMALL LETTER THETA
ZMK_UNICODE_PAIR_AOS(iota , N0 , N3 , B , N9 , N0 , N3 , N9 , N9) //ι Ι |  wm_iota lin_iota GREEK SMALL LETTER IOTA
ZMK_UNICODE_PAIR_AOS(kappa , N0 , N3 , B , A , N0 , N3 , N9 , A) //κ Κ |  wm_kappa lin_kappa GREEK SMALL LETTER KAPPA
ZMK_UNICODE_PAIR_AOS(lamda , N0 , N3 , B , B , N0 , N3 , N9 , B) //λ Λ |  wm_lamda lin_lamda GREEK SMALL LETTER LAMDA
ZMK_UNICODE_PAIR_AOS(mu , N0 , N3 , B , C , N0 , N3 , N9 , C) //μ Μ |  wm_mu lin_mu GREEK SMALL LETTER MU
ZMK_UNICODE_PAIR_AOS(nu , N0 , N3 , B , D , N0 , N3 , N9 , D) //ν Ν |  wm_nu lin_nu GREEK SMALL LETTER NU
ZMK_UNICODE_PAIR_AOS(xi , N0 , N3 , B , E , N0 , N3 , N9 , E) //ξ Ξ |  wm_xi lin_xi GREEK SMALL LETTER XI
ZMK_UNICODE_PAIR_AOS(omicr , N0 , N3 , B , F , N0 , N3 , N9 , F) //ο Ο |  wm_omicr lin_omicr GREEK SMALL LETTER OMICRON
ZMK_UNICODE_PAIR_AOS(pi , N0 , N3 , C , N0 , N0 , N3 , A , N0) //π Π |  wm_pi lin_pi GREEK SMALL LETTER PI
ZMK_UNICODE_PAIR_AOS(rho , N0 , N3 , C , N1 , N0 , N3 , A , N1) //ρ Ρ |  wm_rho lin_rho GREEK SMALL LETTER RHO
ZMK_UNICODE_PAIR_AOS(sigma , N0 , N3 , C , N3 , N0 , N3 , A , N3) //σ Σ |  wm_sigma lin_sigma GREEK SMALL LETTER SIGMA
ZMK_UNICODE_PAIR_AOS(tau , N0 , N3 , C , N4 , N0 , N3 , A , N4) //τ Τ |  wm_tau lin_tau GREEK SMALL LETTER TAU
ZMK_UNICODE_PAIR_AOS(upsil , N0 , N3 , C , N5 , N0 , N3 , A , N5) //υ Υ |  wm_upsil lin_upsil GREEK SMALL LETTER UPSILON
ZMK_UNICODE_PAIR_AOS(phi , N0 , N3 , C , N6 , N0 , N3 , A , N6) //φ Φ |  wm_phi lin_phi GREEK SMALL LETTER PHI
ZMK_UNICODE_PAIR_AOS(chi , N0 , N3 , C , N7 , N0 , N3 , A , N7) //χ Χ |  wm_chi lin_chi GREEK SMALL LETTER CHI
ZMK_UNICODE_PAIR_AOS(psi , N0 , N3 , C , N8 , N0 , N3 , A , N8) //ψ Ψ |  wm_psi lin_psi GREEK SMALL LETTER PSI
ZMK_UNICODE_PAIR_AOS(omega , N0 , N3 , C , N9 , N0 , N3 , A , N9) //ω Ω |  wm_omega lin_omega GREEK SMALL LETTER OMEGA

/* Keymap */

//ZMK_CONDITIONAL_LAYER(sys, FN NUM, SYS) // FN + NUM --> SYS.

//#ifndef ZMK_BASE_LAYER
//  #define ZMK_BASE_LAYER(name, LT, RT, LM, RM, LB, RB, LH, RH)      \
//      ZMK_LAYER(name, LT RT LM RM LB RB LH RH)
//#endif

/* vim: set ft=c tw=146: */

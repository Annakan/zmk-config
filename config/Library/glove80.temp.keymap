#define CONFIG_WIRELESS
#define ZMK_BASE_LAYER(name, LT, RT, LM, RM, LB, RB, LH, RH)                                      \
    ZMK_LAYER(                                                                                    \
        name,                                                                                     \
        &kp F1    &kp F2 &kp F3 &kp F4 &kp F5               &kp F6 &kp F7 &kp F8 &kp F9 &kp F10   \
        &kp EQUAL &kp N1 &kp N2 &kp N3 &kp N4 &kp N5 &kp N6 &kp N7 &kp N8 &kp N9 &kp N0 &kp MINUS \
        &kp TAB              LT                                            RT           &kp BSPC  \
        &kp ESC              LM                                            RM           &none     \
        &none                LB &none  &none  &none  &none  &none &none    RB           &none     \
                                &none  &none &none                                                \
        &kp LEFT  &kp RIGHT  LH &none                             &none    RH    &kp UP &kp DOWN  \
                                                     &none  &none &none)

#include "zmk-helpers/key-labels/glove80.h"
#include "base.keymap"



GLV80_LAYER(Qwerty,
// ╭───────────────┬────────────────────┬───────────────────┬───────────────────┬─────────────────────╮                     ╭─────────────────────┬───────────────────┬─────────────────────┬───────────────────────┬─────────────────╮
     &kp F1          &kp F2               &kp F3               &kp F4             &kp F5                                      &kp F6                 &kp F7             &kp F8                &kp F9                  &kp F10
// ├───────────────┼────────────────────┼───────────────────┼───────────────────┼─────────────────────┼────────╮   ╭────────┼─────────────────────┼───────────────────┼─────────────────────┼───────────────────────┼─────────────────┤
     &q_eql_plus     &kp N1               &kp N2              &kp N3              &kp N4                &kp N5       &kp N6   &kp N7                &kp N8              &kp N9                &kp N0                  &q_minus_unders
// ├───────────────┼────────────────────┼───────────────────┼───────────────────┼─────────────────────┼────────┤   ├────────┼─────────────────────┼───────────────────┼─────────────────────┼───────────────────────┼─────────────────┤
     XXX             &kp Q                &kp W               &kp E               &kp R                 &kp T        &kp Y    &kp U                 &kp I               &kp O                 &kp P                   &q_rslsh_pipe
// ├───────────────┼────────────────────┼───────────────────┼───────────────────┼─────────────────────┼────────┤   ├────────┼─────────────────────┼───────────────────┼─────────────────────┼───────────────────────┼─────────────────┤
     XXX             &hml LGUI A          &hml LALT S         &hml LSHFT D        &hml LCTRL F          &kp G        &kp H    &hmr LCTRL J          &hmr RSHFT K        &hmr LALT L           &hmr LGUI &q_scol_col   &q_quote_sqt
// ├───────────────┼────────────────────┼───────────────────┼───────────────────┼─────────────────────┼────────┤   ├────────┼─────────────────────┼───────────────────┼─────────────────────┼───────────────────────┼─────────────────┤
    &kp GRAVE		 &kp Z                &kp X               &kp C               &kp V                 &kp B    ,   &kp N    &kp M                 &q_comma_lt         &q_dot_gt             &q_slash_qmark          XXX
// ├───────────────┼────────────────────┼───────────────────┼───────────────────┼─────────────────────┼────────┤   ├────────┼─────────────────────┼───────────────────┼─────────────────────┼───────────────────────┼─────────────────┤
     &magic          XXX                  XXX                 NAV_LEFT            NAV_RIGHT                      ,            NAV_UP                NAV_DOWN             &q_lbkt_lcbkt         &q_rbkt_rcbkt          XXX
// ╰───────────────┴────────────────────┴───────────────────┴───────────────────┴─────────────────────╯                     ╰─────────────────────┴───────────────────┴─────────────────────┴───────────────────────┴─────────────────╯
                                                                                                                 ,
//                                                       ╭────────────────┬──────────────────┬──────────────╮               ╭─────────────┬───────────────┬─────────────────────╮
                                                           &kp ESC          &mo NUM            &mo FN                         SMART_NUM     MAGIC_SHIFT     &kp TAB
/*                                                       ├────────────────┼──────────────────┼──────────────┤ */ , /*       ├─────────────┼───────────────┼─────────────────────┤ */
                                                           NAV_BSPC         &lt FN RET         &lt_spc NAV 0                   &to MOUSE    &kp RET         &kp SPACE
//                                                       ╰────────────────┴──────────────────┴──────────────╯               ╰─────────────┴───────────────┴─────────────────────╯

)

GLV80_LAYER(Nav,
// ╭───────────────┬────────────────────┬───────────────────┬───────────────────┬─────────────────────╮                           ╭─────────────────────┬───────────────────┬─────────────────────┬───────────────────────┬───────────╮
     ___             ___                  ___                 ___                 ___                                               ___                   ___                 ___                   ___                     ___
// ├───────────────┼────────────────────┼───────────────────┼───────────────────┼─────────────────────┼───────────╮   ╭───────────┼─────────────────────┼───────────────────┼─────────────────────┼───────────────────────┼───────────┤
     ___             ___                  ___                 ___                 ___                                               ___                   ___                 ___                   ___                     ___
// ├───────────────┼────────────────────┼───────────────────┼───────────────────┼─────────────────────┼───────────┤   ├───────────┼─────────────────────┼───────────────────┼─────────────────────┼───────────────────────┼───────────┤
     ___             ___                  ___                 ___                 ___                                               ___                   ___                 ___                   ___                     ___
// ├───────────────┼────────────────────┼───────────────────┼───────────────────┼─────────────────────┼───────────┤   ├───────────┼─────────────────────┼───────────────────┼─────────────────────┼───────────────────────┼───────────┤
     ___             ___                  ___                  &kp LS(TAB)        &swapper                                           &kp PG_UP            NAV_BSPC           NAV_UP                NAV_DEL                 ___
// ├───────────────┼────────────────────┼───────────────────┼───────────────────┼─────────────────────┼───────────┤   ├───────────┼─────────────────────┼───────────────────┼─────────────────────┼───────────────────────┼───────────┤
     ___             &sk LGUI             &sk LALT            &sk LSHFT           &sk LCTRL                         ,               &kp PG_DN             NAV_LEFT             NAV_DOWN              NAV_RIGHT               &kp RET
// ├───────────────┼────────────────────┼───────────────────┼───────────────────┼─────────────────────┼───────────┤   ├───────────┼─────────────────────┼───────────────────┼─────────────────────┼───────────────────────┼───────────┤
     ___             ___                  ___                 ___                ___                                ,               &kp INS               &kp TAB             ___                   ___                     ___
// ╰───────────────┴────────────────────┴───────────────────┴───────────────────┴─────────────────────╯                           ╰─────────────────────┴───────────────────┴─────────────────────┴───────────────────────┴───────────╯
                                                                                                                    ,
//                                       ╭──────────────────┬──────────────────┬──────────────────────╮                           ╭─────────────────────┬───────────────────┬─────────────────────╮
                                                ___              ___             ___                                               ___                    CANCEL              ___
/*                                       ├──────────────────┼──────────────────┼──────────────────────┤ */          ,     /*      ├─────────────────────┼───────────────────┼─────────────────────┤ */
                                                ___              ___               ___                                                ___                   ___                 ___
//                                       ╰──────────────────┴──────────────────┴──────────────────────╯                           ╰─────────────────────┴───────────────────┴─────────────────────╯

)



GLV80_LAYER(Colemak,
// ╭───────────────┬────────────────────┬───────────────────┬───────────────────┬─────────────────────╮                     ╭─────────────────────┬───────────────────┬─────────────────────┬───────────────────────┬────────────────╮
     &kp F1          &kp F2               &kp F3                  &kp F4         &kp F4                                        &kp F5                &kp F6             &kp F7                &kp F8                  &kp F9
// ├───────────────┼────────────────────┼───────────────────┼───────────────────┼─────────────────────┼────────╮   ╭────────┼─────────────────────┼───────────────────┼─────────────────────┼───────────────────────┼────────────────┤
     &kp GRAVE       &kp N1               &kp N2              &kp N3              &kp N4                &kp N5       &kp N6   &kp N7                &kp N8              &kp N9                &kp N0                  XXX
// ├───────────────┼────────────────────┼───────────────────┼───────────────────┼─────────────────────┼────────┤   ├────────┼─────────────────────┼───────────────────┼─────────────────────┼───────────────────────┼────────────────┤
     XXX             &kp Q                &kp W               &kp F               &kp P                 &kp B        &kp J    &kp L                 &kp U               &kp Y                 &kp SQT                 XXX
// ├───────────────┼────────────────────┼───────────────────┼───────────────────┼─────────────────────┼────────┤   ├────────┼─────────────────────┼───────────────────┼─────────────────────┼───────────────────────┼────────────────┤
     XXX             &hml LGUI A          &hml LALT R         &hml LSHFT S        &hml LCTRL T          &kp G        &kp M    &hmr LCTRL N          &hmr RSHFT E        &hmr LALT I           &hmr LGUI O             XXX
// ├───────────────┼────────────────────┼───────────────────┼───────────────────┼─────────────────────┼────────┤   ├────────┼─────────────────────┼───────────────────┼─────────────────────┼───────────────────────┼────────────────┤
     XXX             &kp Z                &kp X               &kp C               &kp D                 &kp V    ,   &kp K    &kp H                 &comma_morph        &dot_morph            &qexcl                  XXX
// ├───────────────┼────────────────────┼───────────────────┼───────────────────┼─────────────────────┼────────┤   ├────────┼─────────────────────┼───────────────────┼─────────────────────┼───────────────────────┼────────────────┤
     ___             XXX                  XXX                 NAV_LEFT            NAV_RIGHT                      ,            NAV_UP                NAV_DOWN             &kp LPAR             &kp RPAR                XXX
// ╰───────────────┴────────────────────┴───────────────────┴───────────────────┴─────────────────────╯                     ╰─────────────────────┴───────────────────┴─────────────────────┴───────────────────────┴────────────────╯
                                                                                                                 ,
//                                                       ╭────────────────┬──────────────────┬──────────────╮               ╭─────────────┬───────────────┬─────────────────────╮
                                                           ___              ___                ___                            ___           ___             ___
/*                                                       ├────────────────┼──────────────────┼──────────────┤ */ , /*       ├─────────────┼───────────────┼─────────────────────┤ */
                                                           ___              ___               ___                             ___           ___             ___
//                                                       ╰────────────────┴──────────────────┴──────────────╯               ╰─────────────┴───────────────┴─────────────────────╯

)


ZMK_BASE_LAYER(Fn,
//╭─────────────┬─────────────┬─────────────┬─────────────┬─────────────╮ ╭─────────────┬─────────────┬─────────────┬─────────────┬─────────────╮
    &kp F12       &kp F7        &kp F8        &kp F9        ___         ,   ___           &kp C_PREV    &kp C_VOL_UP  &kp C_NEXT    ___         ,
//├─────────────┼─────────────┼─────────────┼─────────────┼─────────────┤ ├─────────────┼─────────────┼─────────────┼─────────────┼─────────────┤
    &hml LGUI F11 &hml LALT F4  &hml LSHFT F5 &hml LCTRL F6 ___         ,   ___           DSK_PREV      VOL_DOWN      DSK_NEXT      ___         ,
//├─────────────┼─────────────┼─────────────┼─────────────┼─────────────┤ ├─────────────┼─────────────┼─────────────┼─────────────┼─────────────┤
    &kp F10       &kp F1        &kp F2        &kp F3        ___         ,   PIN_APP       PIN_WIN       DSK_MGR       ___           ___         ,
//╰─────────────┼─────────────┴─────────────┼─────────────┼─────────────┤ ├─────────────┼─────────────┼─────────────┴───────────────────────────╯
                                              ___           ___         ,   &kp C_MUTE    &kp C_PP
//                                          ╰─────────────┴─────────────╯ ╰─────────────┴─────────────╯
)


ZMK_BASE_LAYER(Num,
//╭─────────────┬─────────────┬─────────────┬─────────────┬─────────────╮ ╭─────────────┬─────────────┬─────────────┬─────────────┬─────────────╮
    ___           &kp N7        &kp N8        &kp N9        ___         ,   ___           ___           ___           ___           ___         ,
//├─────────────┼─────────────┼─────────────┼─────────────┼─────────────┤ ├─────────────┼─────────────┼─────────────┼─────────────┼─────────────┤
    &hml LGUI N0  &hml LALT N4  &hml LSHFT N5 &hml LCTRL N6 ___         ,   ___           ___           ___           ___           ___         ,
//├─────────────┼─────────────┼─────────────┼─────────────┼─────────────┤ ├─────────────┼─────────────┼─────────────┼─────────────┼─────────────┤
    ___           &kp N1        &kp N2        &kp N3        ___         ,   ___           ___           ___           ___           ___         ,
//╰─────────────┼─────────────┴─────────────┼─────────────┼─────────────┤ ├─────────────┼─────────────┼─────────────┴───────────────────────────╯
                                              ___           ___         ,   ___           ___
//                                          ╰─────────────┴─────────────╯ ╰─────────────┴─────────────╯
)


ZMK_BASE_LAYER(Sys,
//╭─────────────┬─────────────┬─────────────┬─────────────┬─────────────╮ ╭─────────────┬─────────────┬─────────────┬─────────────┬─────────────╮
                               _BT_SEL_KEYS_                            ,   ___           ___           ___           ___           ___         ,
//├─────────────┼─────────────┼─────────────┼─────────────┼─────────────┤ ├─────────────┼─────────────┼─────────────┼─────────────┼─────────────┤
    ___           ___           ___           ___           &bootloader ,   &bootloader   ___           ___           ___           ___         ,
//├─────────────┼─────────────┼─────────────┼─────────────┼─────────────┤ ├─────────────┼─────────────┼─────────────┼─────────────┼─────────────┤
    ___           ___           ___           ___           &sys_reset  ,   &sys_reset    ___           ___           ___           ___         ,
//╰─────────────┼─────────────┴─────────────┼─────────────┼─────────────┤ ├─────────────┼─────────────┼─────────────┴───────────────────────────╯
                                              ___           ___         ,   ___           ___
//                                          ╰─────────────┴─────────────╯ ╰─────────────┴─────────────╯
)



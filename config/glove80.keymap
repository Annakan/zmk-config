#define CONFIG_WIRELESS
#define ZMK_BASE_LAYER(name, LT, RT, LM, RM, LB, RB, LH, RH)                                      \
    ZMK_LAYER(                                                                                    \
        name,                                                                                     \
        &kp F1    &kp F2 &kp F3 &kp F4 &kp F5               &kp F6 &kp F7 &kp F8 &kp F9 &kp F10   \
        &kp EQUAL &kp N1 &kp N2 &kp N3 &kp N4 &kp N5 &kp N6 &kp N7 &kp N8 &kp N9 &kp N0 &kp MINUS \
        &kp TAB              LT                                            RT           &kp BSPC  \
        &kp ESC              LM                                            RM           &none     \
        &none                LB &none  &none  &none  &none  &none &none    RB           &none     \
                                &none  &none &none                                                \
        &kp LEFT  &kp RIGHT  LH &none                             &none    RH    &kp UP &kp DOWN  \
                                                     &none  &none &none)

#include "zmk-helpers/key-labels/glove80.h"
#include "base.keymap"
// #include <dt-bindings/zmk/rgb_colors.h>



GLV80_LAYER(Qwerty,
// ╭───────────────┬────────────────────┬───────────────────┬───────────────────┬─────────────────────╮                     ╭─────────────────────┬───────────────────┬─────────────────────┬───────────────────────┬─────────────────╮
     &kp F1          &kp F2               &kp F3               &kp F4             &kp F5                                      &kp F6                 &kp F7             &kp F8                &kp F9                  &kp F10
// ├───────────────┼────────────────────┼───────────────────┼───────────────────┼─────────────────────┼────────╮   ╭────────┼─────────────────────┼───────────────────┼─────────────────────┼───────────────────────┼─────────────────┤
     &q_eql_plus     &kp N1               &kp N2              &kp N3              &kp N4                &kp N5       &kp N6   &kp N7                &kp N8              &kp N9                &kp N0                  &q_minus_unders
// ├───────────────┼────────────────────┼───────────────────┼───────────────────┼─────────────────────┼────────┤   ├────────┼─────────────────────┼───────────────────┼─────────────────────┼───────────────────────┼─────────────────┤
     &tog ErgoL      &kp Q                &kp W               &kp E               &kp R                 &kp T        &kp Y    &kp U                 &kp I               &kp O                 &kp P                   &q_rslsh_pipe
// ├───────────────┼────────────────────┼───────────────────┼───────────────────┼─────────────────────┼────────┤   ├────────┼─────────────────────┼───────────────────┼─────────────────────┼───────────────────────┼─────────────────┤
     &tog OSTOGL      &hml LGUI A          &hml LALT S         &hml LSHFT D        &hml LCTRL F          &kp G        &kp H    &hmr LCTRL J          &hmr RSHFT K        &hmr LALT L           &hmr LGUI &q_scol_col   &q_quote_sqt
// ├───────────────┼────────────────────┼───────────────────┼───────────────────┼─────────────────────┼────────┤   ├────────┼─────────────────────┼───────────────────┼─────────────────────┼───────────────────────┼─────────────────┤
     &kp GRAVE		 &kp Z                &kp X               &kp C               &kp V                 &kp B    ,   &kp N    &kp M                 &q_comma_lt         &q_dot_gt             &q_slash_qmark          XXX
// ├───────────────┼────────────────────┼───────────────────┼───────────────────┼─────────────────────┼────────┤   ├────────┼─────────────────────┼───────────────────┼─────────────────────┼───────────────────────┼─────────────────┤
     &magic SYS 0    XXX                  XXX                 NAV_LEFT            NAV_RIGHT                      ,            NAV_UP                NAV_DOWN             &q_lbkt_lcbkt         &q_rbkt_rcbkt          XXX
// ╰───────────────┴────────────────────┴───────────────────┴───────────────────┴─────────────────────╯                     ╰─────────────────────┴───────────────────┴─────────────────────┴───────────────────────┴─────────────────╯
                                                                                                                 ,
//                                                       ╭────────────────┬──────────────────┬──────────────╮               ╭─────────────┬───────────────┬─────────────────────╮
                                                           &kp ESC          &mo NUM            &lt_spc NAV 0                  SMART_NUM     &kp TAB         &to MOUSE
/*                                                       ├────────────────┼──────────────────┼──────────────┤ */ , /*       ├─────────────┼───────────────┼─────────────────────┤ */
                                                           NAV_BSPC         &lt FN DEL         &kp SPACE                      &kp RET       XXX  		    &mo FN
//                                                       ╰────────────────┴──────────────────┴──────────────╯               ╰─────────────┴───────────────┴─────────────────────╯


)

GLV80_LAYER(ErgoL,
// ╭───────────────┬────────────────────┬───────────────────┬───────────────────┬─────────────────────╮                                 ╭─────────────────────┬───────────────────┬─────────────────────┬───────────────────────┬──────────────╮
     &kp E           ___                  ___                 ___                 ___                                                     ___                   ___                 ___                   ___                     ___
// ├───────────────┼────────────────────┼───────────────────┼───────────────────┼─────────────────────┼───────────────╮  ╭──────────────┼─────────────────────┼───────────────────┼─────────────────────┼───────────────────────┼──────────────┤
     ___             ___                  ___                 ___                 ___                    ___               ___            ___                   ___                 ___                   ___                     ___
// ├───────────────┼────────────────────┼───────────────────┼───────────────────┼─────────────────────┼───────────────┤  ├──────────────┼─────────────────────┼───────────────────┼─────────────────────┼───────────────────────┼──────────────┤
     ___             &kp Q                &kp C               &kp O               &kp P                 &kp W              &kp J          &kp M                 &kp D               Q_DEAD_KEY            &kp Y                   ___
// ├───────────────┼────────────────────┼───────────────────┼───────────────────┼─────────────────────┼───────────────┤  ├──────────────┼─────────────────────┼───────────────────┼─────────────────────┼───────────────────────┼──────────────┤
     ___             &hml LGUI A          &hml LALT S         &hml LSHFT E        &hml LCTRL N          &kp F              &kp L          &hmr LCTRL R          &hmr RSHFT T        &hmr LALT I           &hmr LGUI U             ___
// ├───────────────┼────────────────────┼───────────────────┼───────────────────┼─────────────────────┼───────────────┤  ├──────────────┼─────────────────────┼───────────────────┼─────────────────────┼───────────────────────┼──────────────┤
     ___             &kp Z                &kp X               ___                 &kp V                 &kp B            ,  ___           &kp H                 &kp G               ___                   &kp K                   ___
// ├───────────────┼────────────────────┼───────────────────┼───────────────────┼─────────────────────┼───────────────┤  ├──────────────┼─────────────────────┼───────────────────┼─────────────────────┼───────────────────────┼──────────────┤
     ___             ___                  ___                 ___                 ___                                    ,                ___                   ___                 ___                   ___                     ___
// ╰───────────────┴────────────────────┴───────────────────┴───────────────────┴─────────────────────╯                                 ╰─────────────────────┴───────────────────┴─────────────────────┴───────────────────────┴──────────────╯
                                                                                                                        ,
//                                       ╭──────────────────┬──────────────────┬──────────────────────╮                                 ╭─────────────────────┬───────────────────┬─────────────────────╮
                                                ___              ___                   ___                                                   ___                  ___                 ___
/*                                       ├──────────────────┼──────────────────┼──────────────────────┤ */              ,  /*           ├─────────────────────┼───────────────────┼─────────────────────┤ */
                                                ___              ___                   ___                                                   ___                  ___                 ___
//                                       ╰──────────────────┴──────────────────┴──────────────────────╯                                 ╰─────────────────────┴───────────────────┴─────────────────────╯

)




GLV80_LAYER(Nav,
// ╭───────────────┬────────────────────┬───────────────────┬───────────────────┬─────────────────────╮                           ╭─────────────────────┬───────────────────┬─────────────────────┬───────────────────────┬───────────╮
     ___             ___                  ___                 ___                 ___                                               ___                   ___                 ___                   ___                     ___
// ├───────────────┼────────────────────┼───────────────────┼───────────────────┼─────────────────────┼───────────╮   ╭───────────┼─────────────────────┼───────────────────┼─────────────────────┼───────────────────────┼───────────┤
     ___             ___                  ___                 ___                 ___                                               ___                   ___                 ___                   ___                     ___
// ├───────────────┼────────────────────┼───────────────────┼───────────────────┼─────────────────────┼───────────┤   ├───────────┼─────────────────────┼───────────────────┼─────────────────────┼───────────────────────┼───────────┤
     ___             ___                  ___                 ___                 ___                                   ___         &kp PG_UP             NAV_UP              &kp INS                ___                     ___
// ├───────────────┼────────────────────┼───────────────────┼───────────────────┼─────────────────────┼───────────┤   ├───────────┼─────────────────────┼───────────────────┼─────────────────────┼───────────────────────┼───────────┤
     ___             ___                  ___                  &kp LS(TAB)        &swapper                              ___         NAV_LEFT              NAV_DOWN            NAV_RIGHT             &kp RET                 ___
// ├───────────────┼────────────────────┼───────────────────┼───────────────────┼─────────────────────┼───────────┤   ├───────────┼─────────────────────┼───────────────────┼─────────────────────┼───────────────────────┼───────────┤
     ___             &sk LGUI             &sk LALT            &sk LSHFT           &sk LCTRL                         ,    ___        &kp PG_DN              ___                  ___                 ___                     ___
// ├───────────────┼────────────────────┼───────────────────┼───────────────────┼─────────────────────┼───────────┤   ├───────────┼─────────────────────┼───────────────────┼─────────────────────┼───────────────────────┼───────────┤
     ___             ___                  ___                 ___                ___                                ,               ___                   &kp TAB             ___                   ___                     ___
// ╰───────────────┴────────────────────┴───────────────────┴───────────────────┴─────────────────────╯                           ╰─────────────────────┴───────────────────┴─────────────────────┴───────────────────────┴───────────╯
                                                                                                                    ,
//                                       ╭──────────────────┬──────────────────┬──────────────────────╮                           ╭─────────────────────┬───────────────────┬─────────────────────╮
                                                ___              ___             ___                                                 NAV_DEL                    CANCEL              ___
/*                                       ├──────────────────┼──────────────────┼──────────────────────┤ */          ,     /*      ├─────────────────────┼───────────────────┼─────────────────────┤ */
                                                ___              ___               ___                                               NAV_BSPC                   ___                 ___
//                                       ╰──────────────────┴──────────────────┴──────────────────────╯                           ╰─────────────────────┴───────────────────┴─────────────────────╯

)


ZMK_BASE_LAYER(Fn,
//╭─────────────┬─────────────┬─────────────┬─────────────┬─────────────╮ ╭─────────────┬─────────────┬─────────────┬─────────────┬─────────────╮
    &kp F12       &kp F7        &kp F8        &kp F9        ___         ,   ___           &kp C_PREV    &kp C_VOL_UP  &kp C_NEXT    ___         ,
//├─────────────┼─────────────┼─────────────┼─────────────┼─────────────┤ ├─────────────┼─────────────┼─────────────┼─────────────┼─────────────┤
    &hml LGUI F11 &hml LALT F4  &hml LSHFT F5 &hml LCTRL F6 ___         ,   ___           DSK_PREV      VOL_DOWN      DSK_NEXT      ___         ,
//├─────────────┼─────────────┼─────────────┼─────────────┼─────────────┤ ├─────────────┼─────────────┼─────────────┼─────────────┼─────────────┤
    &kp F10       &kp F1        &kp F2        &kp F3        ___         ,   PIN_APP       PIN_WIN       DSK_MGR       ___           ___         ,
//╰─────────────┼─────────────┴─────────────┼─────────────┼─────────────┤ ├─────────────┼─────────────┼─────────────┴───────────────────────────╯
                                              ___           ___         ,   &kp C_MUTE    &kp C_PP
//                                          ╰─────────────┴─────────────╯ ╰─────────────┴─────────────╯
)


ZMK_BASE_LAYER(Num,
//╭─────────────┬─────────────┬─────────────┬─────────────┬─────────────╮ ╭─────────────┬─────────────┬─────────────┬─────────────┬─────────────╮
    ___           &kp N7        &kp N8        &kp N9        ___         ,   ___           ___           ___           ___           ___         ,
//├─────────────┼─────────────┼─────────────┼─────────────┼─────────────┤ ├─────────────┼─────────────┼─────────────┼─────────────┼─────────────┤
    &hml LGUI N0  &hml LALT N4  &hml LSHFT N5 &hml LCTRL N6 ___         ,   ___           ___           ___           ___           ___         ,
//├─────────────┼─────────────┼─────────────┼─────────────┼─────────────┤ ├─────────────┼─────────────┼─────────────┼─────────────┼─────────────┤
    ___           &kp N1        &kp N2        &kp N3        ___         ,   ___           ___           ___           ___           ___         ,
//╰─────────────┼─────────────┴─────────────┼─────────────┼─────────────┤ ├─────────────┼─────────────┼─────────────┴───────────────────────────╯
                                              ___           ___         ,   ___           ___
//                                          ╰─────────────┴─────────────╯ ╰─────────────┴─────────────╯
)


ZMK_BASE_LAYER(Mouse,
//╭─────────────┬─────────────┬─────────────┬─────────────┬─────────────╮ ╭─────────────┬─────────────┬─────────────┬─────────────┬─────────────╮
    ___           ___           ___           ___           ___         ,   ___           &kp PG_UP     U_MS_U         &kp PG_DN    ___         ,
//├─────────────┼─────────────┼─────────────┼─────────────┼─────────────┤ ├─────────────┼─────────────┼─────────────┼─────────────┼─────────────┤
    ___           ___           ___           ___           ___         ,   U_WH_L        U_MS_L        U_MS_D         U_MS_R       U_WH_R      ,
//├─────────────┼─────────────┼─────────────┼─────────────┼─────────────┤ ├─────────────┼─────────────┼─────────────┼─────────────┼─────────────┤
    ___           ___           ___           ___           ___         ,   ___           &mkp LCLK     &mkp MCLK      &mkp RCLK    ___         ,
//╰─────────────┼─────────────┴─────────────┼─────────────┼─────────────┤ ├─────────────┼─────────────┼─────────────┴───────────────────────────╯
                                              ___           ___         ,   U_WH_U        U_WH_D
//                                          ╰─────────────┴─────────────╯ ╰─────────────┴─────────────╯
)


ZMK_BASE_LAYER(Sys,
//╭─────────────┬─────────────┬─────────────┬─────────────┬─────────────╮ ╭─────────────┬─────────────┬─────────────┬─────────────┬─────────────╮
                               _BT_SEL_KEYS_                            ,   ___           ___           ___           ___           ___         ,
//├─────────────┼─────────────┼─────────────┼─────────────┼─────────────┤ ├─────────────┼─────────────┼─────────────┼─────────────┼─────────────┤
    ___           ___           ___           ___           &bootloader ,   &bootloader   ___           ___           ___           ___         ,
//├─────────────┼─────────────┼─────────────┼─────────────┼─────────────┤ ├─────────────┼─────────────┼─────────────┼─────────────┼─────────────┤
    ___           ___           ___           ___           &sys_reset  ,   &sys_reset    ___           ___           ___           ___         ,
//╰─────────────┼─────────────┴─────────────┼─────────────┼─────────────┤ ├─────────────┼─────────────┼─────────────┴───────────────────────────╯
                                              ___           ___         ,   ___           ___
//                                          ╰─────────────┴─────────────╯ ╰─────────────┴─────────────╯
)

GLV80_LAYER(OSTOGL,
// ╭───────────────┬────────────────────┬───────────────────┬───────────────────┬─────────────────────╮                                 ╭─────────────────────┬───────────────────┬─────────────────────┬───────────────────────┬──────────────╮
     &kp O           ___                  ___                 ___                 ___                                                     ___                   ___                 ___                   ___                     ___
// ├───────────────┼────────────────────┼───────────────────┼───────────────────┼─────────────────────┼───────────────╮  ╭──────────────┼─────────────────────┼───────────────────┼─────────────────────┼───────────────────────┼──────────────┤
     ___             ___                  ___                 ___                 ___                    ___               ___            ___                   ___                 ___                   ___                     ___
// ├───────────────┼────────────────────┼───────────────────┼───────────────────┼─────────────────────┼───────────────┤  ├──────────────┼─────────────────────┼───────────────────┼─────────────────────┼───────────────────────┼──────────────┤
     ___             ___                  ___                 ___                 ___                   ___               ___            ___                   ___                 ___                   ___                     ___
// ├───────────────┼────────────────────┼───────────────────┼───────────────────┼─────────────────────┼───────────────┤  ├──────────────┼─────────────────────┼───────────────────┼─────────────────────┼───────────────────────┼──────────────┤
     ___             ___                  ___                 ___                 ___                    ___               ___            ___                   ___                 ___                   ___                     ___
// ├───────────────┼────────────────────┼───────────────────┼───────────────────┼─────────────────────┼───────────────┤  ├──────────────┼─────────────────────┼───────────────────┼─────────────────────┼───────────────────────┼──────────────┤
     ___             ___                  ___                 ___                 ___                    ___            ,  ___            ___                   ___                 ___                   ___                     ___
// ├───────────────┼────────────────────┼───────────────────┼───────────────────┼─────────────────────┼───────────────┤  ├──────────────┼─────────────────────┼───────────────────┼─────────────────────┼───────────────────────┼──────────────┤
     ___             ___                  ___                 ___                 ___                                    ,                ___                   ___                 ___                   ___                     ___
// ╰───────────────┴────────────────────┴───────────────────┴───────────────────┴─────────────────────╯                                 ╰─────────────────────┴───────────────────┴─────────────────────┴───────────────────────┴──────────────╯
                                                                                                                        ,
//                                       ╭──────────────────┬──────────────────┬──────────────────────╮                                 ╭─────────────────────┬───────────────────┬─────────────────────╮
                                                ___              ___                   ___                                                       ___                   ___                 ___
/*                                       ├──────────────────┼──────────────────┼──────────────────────┤ */              ,  /*           ├─────────────────────┼───────────────────┼─────────────────────┤ */
                                                ___              ___                   ___                                                       ___                   ___                 ___
//                                       ╰──────────────────┴──────────────────┴──────────────────────╯                                 ╰─────────────────────┴───────────────────┴─────────────────────╯

)

// lAYER FOR LINUX accentuated letters
GLV80_LAYER(LinAcc,
/// ╭───────────────┬────────────────────┬───────────────────┬───────────────────┬─────────────────────╮                                 ╭─────────────────────┬───────────────────┬─────────────────────┬───────────────────────┬──────────────╮
     &kp L           ___                  ___                 ___                 ___                                                     ___                   ___                 ___                   ___                     ___
// ├───────────────┼────────────────────┼───────────────────┼───────────────────┼─────────────────────┼───────────────╮  ╭──────────────┼─────────────────────┼───────────────────┼─────────────────────┼───────────────────────┼──────────────┤
     ___             ___                  ___                 ___                 ___                    ___               ___            ___                   ___		  			___                   ___                     ___
// ├───────────────┼────────────────────┼───────────────────┼───────────────────┼─────────────────────┼───────────────┤  ├──────────────┼─────────────────────┼───────────────────┼─────────────────────┼───────────────────────┼──────────────┤
     ___             &lin_a_circu         &lin_c_cedil        &lin_ligat_oe       &lin_o_circu           ___                ___           &lin_micro_sign       &kp UNDER           ___                   &lin_u_circu             ___
// ├───────────────┼────────────────────┼───────────────────┼───────────────────┼─────────────────────┼───────────────┤  ├──────────────┼─────────────────────┼───────────────────┼─────────────────────┼───────────────────────┼──────────────┤
     ___             &lin_a_grave         &lin_e_acute        &lin_e_grave        &lin_a_circu            ___              &kp LPAR       &kp RPAR              &lin_i_circu         &lin_i_diaer         &lin_u_grave             ___
// ├───────────────┼────────────────────┼───────────────────┼───────────────────┼─────────────────────┼───────────────┤  ├──────────────┼─────────────────────┼───────────────────┼─────────────────────┼───────────────────────┼──────────────┤
     ___             &lin_ae                 ___                 ___                 ___                    ___         , &lin_horiz_ellip ___                   ___                 ___                   &kp DOT                 ___
// ├───────────────┼────────────────────┼───────────────────┼───────────────────┼─────────────────────┼───────────────┤  ├──────────────┼─────────────────────┼───────────────────┼─────────────────────┼───────────────────────┼──────────────┤
     ___             ___                  ___                 ___                 ___                                   ,                  ___                 ___                  ___                   ___                     ___
// ╰───────────────┴────────────────────┴───────────────────┴───────────────────┴─────────────────────╯                                 ╰─────────────────────┴───────────────────┴─────────────────────┴───────────────────────┴──────────────╯
                                                                                                                        ,
//                                       ╭──────────────────┬──────────────────┬──────────────────────╮                                 ╭─────────────────────┬───────────────────┬─────────────────────╮
                                                ___              ___                   ___                                                       ___                   ___                 ___
/*                                       ├──────────────────┼──────────────────┼──────────────────────┤ */              ,  /*           ├─────────────────────┼───────────────────┼─────────────────────┤ */
                                                ___              ___              &kp APOS                                                       ___                   ___                 ___
//                                       ╰──────────────────┴──────────────────┴──────────────────────╯                                 ╰─────────────────────┴───────────────────┴─────────────────────╯
)

//lAYER FOR WIN MAC accentuated letters
GLV80_LAYER(WMAcc,
// ╭───────────────┬────────────────────┬───────────────────┬───────────────────┬─────────────────────╮                                 ╭─────────────────────┬───────────────────┬─────────────────────┬───────────────────────┬──────────────╮
     &kp W           ___                  ___                 ___                 ___                                                     ___                   ___                 ___                   ___                     ___
// ├───────────────┼────────────────────┼───────────────────┼───────────────────┼─────────────────────┼───────────────╮  ╭──────────────┼─────────────────────┼───────────────────┼─────────────────────┼───────────────────────┼──────────────┤
     ___             ___                  ___                 ___                 ___                    ___               ___            ___                   ___		  			___                   ___                     ___
// ├───────────────┼────────────────────┼───────────────────┼───────────────────┼─────────────────────┼───────────────┤  ├──────────────┼─────────────────────┼───────────────────┼─────────────────────┼───────────────────────┼──────────────┤
     ___             &wm_a_circu          &wm_c_cedil         &wm_ligat_oe        &wm_o_circu           ___                ___            &wm_micro_sign        &kp UNDER           ___                   &wm_u_circu             ___
// ├───────────────┼────────────────────┼───────────────────┼───────────────────┼─────────────────────┼───────────────┤  ├──────────────┼─────────────────────┼───────────────────┼─────────────────────┼───────────────────────┼──────────────┤
     ___             &wm_a_grave          &wm_e_acute         &wm_e_grave         &wm_a_circu            ___               &kp LPAR       &kp RPAR              &wm_i_circu         &wm_i_diaer           &wm_u_grave             ___
// ├───────────────┼────────────────────┼───────────────────┼───────────────────┼─────────────────────┼───────────────┤  ├──────────────┼─────────────────────┼───────────────────┼─────────────────────┼───────────────────────┼──────────────┤
     ___             &wm_ae                 ___                 ___                 ___                    ___          , &wm_horiz_ellip ___                   ___                 ___                   &kp DOT                 ___
// ├───────────────┼────────────────────┼───────────────────┼───────────────────┼─────────────────────┼───────────────┤  ├──────────────┼─────────────────────┼───────────────────┼─────────────────────┼───────────────────────┼──────────────┤
     ___             ___                  ___                 ___                 ___                                   ,                  ___                 ___                  ___                   ___                     ___
// ╰───────────────┴────────────────────┴───────────────────┴───────────────────┴─────────────────────╯                                 ╰─────────────────────┴───────────────────┴─────────────────────┴───────────────────────┴──────────────╯
                                                                                                                        ,
//                                       ╭──────────────────┬──────────────────┬──────────────────────╮                                 ╭─────────────────────┬───────────────────┬─────────────────────╮
                                                ___              ___                   ___                                                       ___                   ___                 ___
/*                                       ├──────────────────┼──────────────────┼──────────────────────┤ */              ,  /*           ├─────────────────────┼───────────────────┼─────────────────────┤ */
                                                ___              ___              &kp APOS                                                       ___                   ___                 ___
//                                       ╰──────────────────┴──────────────────┴──────────────────────╯                                 ╰─────────────────────┴───────────────────┴─────────────────────╯

)

GLV80_LAYER(Symbol,
                    // ╭────────────┬────────────┬────────────┬────────────┬────────────╮                                              ╭────────────┬─────────────┬────────────┬────────────┬────────────╮
                          &kp S       XXX          XXX          XXX          XXX                                                         XXX          XXX           XXX          XXX          XXX
                    // ├────────────┼────────────┼────────────┼────────────┼────────────┼────────────╮                    ╭────────────┼────────────┼─────────────┼────────────┼────────────┼────────────┤
                         XXX          XXX          XXX          XXX           XXX          XXX                              XXX          XXX          XXX           XXX          XXX          XXX
                    // ├────────────┼────────────┼────────────┼────────────┼────────────┼────────────┤                    ├────────────┼────────────┼─────────────┼────────────┼────────────┼────────────┤
                         XXX          &kp CARET    &kp LT       &kp GT       &kp DLLR    &kp PERCENT                        &kp AT_SIGN  &kp AMPS     &kp STAR      &kp SQT      &kp GRAVE    XXX
                    // ├────────────┼────────────┼────────────┼────────────┼────────────┼────────────┤                    ├────────────┼────────────┼─────────────┼────────────┼────────────┼────────────┤
                         XXX          &kp LBRC     &kp LPAR     &kp RPAR     &kp RBRC     &kp EQUAL                         &kp BSLH     &kp PLUS     &kp MINUS     &kp SLASH    &kp DQT      XXX
                    // ├────────────┼────────────┼────────────┼────────────┼────────────┼────────────┤                    ├────────────┼────────────┼─────────────┼────────────┼────────────┼────────────┤
                         XXX          &kp TILDE    &kp LBKT     &kp RBKT     &kp UNDER    &kp HASH                      ,   &kp PIPE     &kp LS(N1)  &kp SEMI      &kp COLON     &kp QMARK    XXX
                    // ├────────────┼────────────┼────────────┼────────────┼────────────┼────────────╯                    ╰────────────┼────────────┼─────────────┼────────────┼────────────┼────────────┤
                         XXX          XXX          XXX          XXX          XXX                                        ,                XXX          XXX           XXX          XXX          XXX
                    // ╰────────────┴────────────┴────────────┴────────────┴────────────╯                                              ╰────────────┴─────────────┴────────────┴────────────┴────────────╯
                                                                                   ,
                    //                                   ╭────────────┬────────────┬──────────────╮                          ╭────────────┬────────────┬────────────╮
                                                           ___          ___          ___                                       ___          ___          ___
                    /*                                   ├────────────┼────────────┼──────────────┤ */                  , /* ├────────────┼────────────┼────────────┤ */
                                                           ___          ___          ___                                       ___          ___          ___
                    //                                   ╰────────────┴────────────┴──────────────╯                          ╰────────────┴────────────┴────────────╯
)

/// {
//    underglow-layer {
//        compatible  = "zmk,underglow-layer";
//
//      ug_base {
//            bindings = <
//    &ug ___ &ug ___         &ug ___         &ug ___         &ug ___                                                                                          &ug ___         &ug ___         &ug ___         &ug ___         &ug ___
//    &ug ___ &ug_cl ___ TEAL &ug_cl ___ TEAL &ug_cl ___ TEAL &ug_cl ___ TEAL &ug_cl ___ TEAL                                                  &ug_cl ___ TEAL &ug_cl ___ TEAL &ug_cl ___ TEAL &ug_cl ___ TEAL &ug_cl ___ TEAL &ug ___
//    &ug ___ &ug_cl ___ TEAL &ug_cl ___ TEAL &ug_cl ___ TEAL &ug_cl ___ TEAL &ug_cl ___ TEAL                                                  &ug_cl ___ TEAL &ug_cl ___ TEAL &ug_cl ___ TEAL &ug_cl ___ TEAL &ug ___         &ug ___
//    &ug ___ &ug_cl ___ TEAL &ug_cl ___ TEAL &ug_cl ___ TEAL &ug_cl ___ TEAL &ug_cl ___ TEAL                                                  &ug_cl ___ TEAL &ug_cl ___ TEAL &ug_cl ___ TEAL &ug_cl ___ TEAL &ug_cl ___ TEAL &ug ___
//    &ug ___ &ug_cl ___ TEAL &ug_cl ___ TEAL &ug_cl ___ TEAL &ug_cl ___ TEAL &ug_cl ___ TEAL &ug ___ &ug ___ &ug ___  &ug ___ &ug ___ &ug ___ &ug_cl ___ TEAL &ug_cl ___ TEAL &ug ___         &ug ___         &ug ___         &ug ___
//    &ug ___ &ug ___         &ug ___         &ug ___         &ug ___                         &ug ___ &ug ___ &ug ___  &ug ___ &ug ___ &ug ___                 &ug ___         &ug ___         &ug ___         &ug ___         &ug ___
//                >;
//            layer-id = <QWERTY>;
//        };
//    };
//};